// Minimal display test - no KWP/OBD bloat
#include <Arduino.h>
#include <Wire.h>

const uint8_t OLED_I2C_ADDR = 0x3C;

// Compile-time text length validation
#define ADD_TEXT_SAFE(x, line, s, scale) \
    do { \
        static_assert((sizeof(s) - 1) * (6 * (scale)) + (x) <= 64, \
                      "Text too long for display width"); \
        addText((x), (line), (s), (scale)); \
    } while(0)

// U8g2 SH1107 64x128 init sequence (from u8x8_d_sh1107.c)
const uint8_t PROGMEM kInit[] = {
    0xAE,       // display off
    0xDC, 0x00, // display start line = 0 (SH1107 command, not SSD1306)
    0x81, 0x2F, // contrast
    0x20,       // memory addressing mode: page
    0xA1,       // segment remap
    0xC8,       // COM scan dir
    0xA8, 0x7F, // multiplex ratio = 128
    0xD3, 0x00, // display offset = 0
    0xD5, 0x51, // clock divide / osc frequency
    0xD9, 0x22, // pre-charge period
    0xDB, 0x35, // VCOMH deselect level
    0xDA, 0x12, // COM pins config
    0xA4,       // output follows RAM
    0xA6,       // normal (non-inverted)
    0xAF,       // display on
};

// Text entry: position, content, scale
struct TextEntry {
    uint8_t x;
    uint8_t line;
    const char* text;
    uint8_t scale;
};

TextEntry texts[20];
uint8_t textCount = 0;

// 5x7 font: one byte per column, 5 columns per character
// ASCII 0x20 (space) through 0x7F
const uint8_t PROGMEM kFont[] = {
    0x00, 0x00, 0x00, 0x00, 0x00, // 0x20 space
    0x00, 0x00, 0x5F, 0x00, 0x00, // !
    0x00, 0x07, 0x00, 0x07, 0x00, // "
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    0x00, 0x00, 0x00, 0x00, 0x00, // 0x7F
};

void writeCmd(uint8_t c)
{
    Wire.beginTransmission(OLED_I2C_ADDR);
    Wire.write(0x00);
    Wire.write(c);
    Wire.endTransmission();
}

void sendInit()
{
    for (uint8_t i = 0; i < sizeof(kInit); ++i)
    {
        writeCmd(pgm_read_byte(&kInit[i]));
        delay(5);  // Add delay between commands for stability
    }
    delay(200);  // Wait for display to stabilize after init
}

void setPixel(uint8_t x, uint8_t y, uint8_t* pageBuf, bool on)
{
    if (x >= 64 || y >= 128)
        return;
    uint8_t page = y / 8;
    uint8_t bit = y % 8;
    uint8_t idx = x;
    if (on)
        pageBuf[idx] |= (1u << bit);
    else
        pageBuf[idx] &= ~(1u << bit);
}

void drawCharToPage(uint8_t x, uint8_t y, char c, uint8_t scale, uint8_t page, uint8_t* pageBuf)
{
    if (x >= 64 || y >= 128)
        return;
    uint8_t glyph = ((uint8_t)c < 0x20 || (uint8_t)c > 0x7F) ? 0 : (uint8_t)(c - 0x20);
    const uint8_t* g = &kFont[(uint16_t)glyph * 5];

    for (uint8_t cx = 0; cx < 6; ++cx)
    {
        uint8_t bits = (cx < 5) ? pgm_read_byte(g + cx) : 0x00;
        for (uint8_t by = 0; by < 8; ++by)
        {
            bool pixel = (by < 7) && (bits & (1u << by));
            if (scale == 1)
            {
                uint8_t py = y + by;
                if (py / 8 == page)
                    setPixel(x + cx, py, pageBuf, pixel);
            }
            else if (scale == 2)
            {
                for (uint8_t sy = 0; sy < 2; ++sy)
                {
                    uint8_t py = y + by * 2 + sy;
                    if (py / 8 == page)
                    {
                        setPixel(x + cx * 2, py, pageBuf, pixel);
                        setPixel(x + cx * 2 + 1, py, pageBuf, pixel);
                    }
                }
            }
        }
    }
}

void addText(uint8_t x, uint8_t line, const char* s, uint8_t scale)
{
    if (textCount < 20)
    {
        texts[textCount].x = x;
        texts[textCount].line = line;
        texts[textCount].text = s;
        texts[textCount].scale = scale;
        textCount++;
    }
}

void clearText()
{
    textCount = 0;
}

void flushDisplay()
{
    for (uint8_t page = 0; page < 16; ++page)
    {
        uint8_t pageBuf[64] = {0};

        for (uint8_t t = 0; t < textCount; ++t)
        {
            uint8_t y = texts[t].line * (8 * texts[t].scale);
            const char* s = texts[t].text;
            uint8_t x = texts[t].x;
            uint8_t scale = texts[t].scale;

            while (*s && x < 64)
            {
                drawCharToPage(x, y, *s++, scale, page, pageBuf);
                x += 6 * scale;
            }
        }

        writeCmd((uint8_t)(0xB0 | page));
        writeCmd(0x00);
        writeCmd(0x12);

        uint8_t col = 0;
        while (col < 64)
        {
            Wire.beginTransmission(OLED_I2C_ADDR);
            Wire.write(0x40);
            uint8_t n = 0;
            while (col < 64 && n < 16)
            {
                Wire.write(pageBuf[col]);
                ++col;
                ++n;
            }
            Wire.endTransmission();
        }
    }
}

void setup()
{
    Serial.begin(115200);
    delay(500);
    Serial.println(F("\n\nDisplay Test - Minimal"));

    Wire.begin();
    Wire.setClock(100000);
    Serial.println(F("Wire initialized at 100kHz"));

    // Send display OFF command first to reset state
    Serial.println(F("Sending display OFF..."));
    writeCmd(0xAE);
    delay(100);

    Serial.println(F("Sending init..."));
    sendInit();
    Serial.println(F("Init sent"));

    delay(500);  // Extra stabilization time

    Serial.println(F("Clearing display..."));

    for (uint8_t page = 0; page < 16; ++page)
    {
        writeCmd((uint8_t)(0xB0 | page));
        writeCmd(0x00);
        writeCmd(0x10);

        Wire.beginTransmission(OLED_I2C_ADDR);
        Wire.write(0x40);
        for (uint8_t col = 0; col < 64; ++col)
            Wire.write(0x00);
        Wire.endTransmission();
    }
    Serial.println(F("Display cleared"));

    delay(500);

    Serial.println(F("Adding text..."));
    clearText();

    ADD_TEXT_SAFE(2, 0, "Small", 1);
    ADD_TEXT_SAFE(2, 1, "Line", 1);
    ADD_TEXT_SAFE(2, 2, "Text", 1);

    ADD_TEXT_SAFE(2, 4, "BIG", 2);

    ADD_TEXT_SAFE(2, 10, "More", 1);
    ADD_TEXT_SAFE(2, 12, "End", 1);

    Serial.println(F("Flushing display..."));
    flushDisplay();
    Serial.println(F("Text sent!"));

    delay(3000);

    Serial.println(F("Clearing..."));
    clearText();

    for (uint8_t page = 0; page < 16; ++page)
    {
        writeCmd((uint8_t)(0xB0 | page));
        writeCmd(0x02);  // Column offset: same as above
        writeCmd(0x10);

        Wire.beginTransmission(OLED_I2C_ADDR);
        Wire.write(0x40);
        for (uint8_t col = 0; col < 64; ++col)
            Wire.write(0x00);
        Wire.endTransmission();
    }
    Serial.println(F("Display cleared"));
}

void loop()
{
    delay(1000);
    Serial.println(F("Alive"));
}
